## arch/arm/configs/msm8974_sec_ks01_eur_defconfig
```kconfig
# from msm8974_sec_defconfig
CONFIG_MSM_RUN_QUEUE_STATS=y
CONFIG_MSM_RUN_QUEUE_STATS_BE_CONSERVATIVE=y
CONFIG_SURF_FFA_GPIO_KEYPAD=n
CONFIG_AUDIT=y
CONFIG_MSM_PIL_PRONTO=n
CONFIG_KSM=y
CONFIG_DEVMEM=n
CONFIG_DEVKMEM=n
CONFIG_NET_KEY=y
CONFIG_IP_MULTICAST=y
CONFIG_INET_XFRM_MODE_TRANSPORT=y
CONFIG_INET_XFRM_MODE_TUNNEL=y
CONFIG_NF_CONNTRACK_SECMARK=y
# CONFIG_NF_CONNTRACK_SIP is not set
CONFIG_NETFILTER_XT_TARGET_CONNSECMARK=y
CONFIG_NETFILTER_XT_TARGET_NOTRACK=y
CONFIG_NETFILTER_XT_TARGET_SECMARK=y
CONFIG_NETFILTER_XT_TARGET_TCPMSS=y
CONFIG_IP_NF_SECURITY=y
CONFIG_L2TP=y
CONFIG_STP=y
CONFIG_BRIDGE=y
CONFIG_BRIDGE_IGMP_SNOOPING=y
CONFIG_PPP=y
CONFIG_PPP_BSDCOMP=y
CONFIG_PPP_DEFLATE=y
CONFIG_PPP_FILTER=y
CONFIG_PPP_MPPE=y
CONFIG_PPP_MULTILINK=y
CONFIG_PPPOE=y
CONFIG_PPPOL2TP=y
CONFIG_PPPOLAC=y
CONFIG_PPPOPNS=y
CONFIG_PPP_ASYNC=y
CONFIG_PPP_SYNC_TTY=y
CONFIG_SLIP=y
CONFIG_SLHC=y
CONFIG_SLIP_COMPRESSED=y
# CONFIG_WCNSS_CORE is not set
# CONFIG_WCNSS_CORE_PRONTO is not set
# CONFIG_WCNSS_MEM_PRE_ALLOC is not set
CONFIG_SENSORS_QPNP_ADC_CURRENT=n
CONFIG_IMX135=y
CONFIG_MSM_WFD=n
# CONFIG_MSM_DCVS=y
#CONFIG_FB_MSM_MDSS_HDMI_MHL_SII8334=y
#CONFIG_FB_MSM_MDSS_DBG_SEQ_TICK=y
#CONFIG_FB_MSM_MDSS_DSI_DBG=y
CONFIG_SND_SOC_MSM_HDMI_CODEC_RX=y
CONFIG_MDNIE_LITE_TUNING=y
CONFIG_GAMMA_CONTROL=y
CONFIG_LEDS_AN30259A=y
CONFIG_FB_MSM_MIPI_SAMSUNG_OCTA_VIDEO_FULL_HD_PT_PANEL=y
#CONFIG_IIO=y
#CONFIG_IIO_BUFFER=y
# CONFIG_IIO_SW_RING is not set
#CONFIG_IIO_KFIFO_BUF=y
#CONFIG_IIO_TRIGGER=y
#CONFIG_IIO_ST_HWMON=y
# CONFIG_INV_MPU_IIO is not set
# CONFIG_SENSORS_GP2A_IIO is not set
# CONFIG_SENSORS_CORE is not set
# CONFIG_INV_TESTING is not set
CONFIG_EXT4_FS_SECURITY=y
CONFIG_ENABLE_DEFAULT_TRACERS=y
CONFIG_SECURITY=y
CONFIG_SECURITY_NETWORK=y
CONFIG_LSM_MMAP_MIN_ADDR=4096
CONFIG_SECURITY_SELINUX=y

# KS01LTE config
CONFIG_SEC_KS01_PROJECT=y
CONFIG_SEC_LOCALE_EUR=y
CONFIG_SEC_LOCALE_KOR=y
CONFIG_SEC_OPERATOR_OPEN=y
CONFIG_MACH_KS01SKT=y
CONFIG_MACH_KS01EUR=y
CONFIG_LCD_CLASS_DEVICE=y
CONFIG_BACKLIGHT_LCD_SUPPORT=y
CONFIG_BACKLIGHT_CLASS_DEVICE=y

#
# MAX77803 IC
#
CONFIG_MAX77803_MUIC=y
CONFIG_MFD_MAX77803=y
CONFIG_REGULATOR_MAX77803=y
CONFIG_MOTOR_DRV_MAX77803=y
CONFIG_VIBETONZ=y
CONFIG_LEDS_MAX77803=y

#
# Battery & Charger
#
# CONFIG_SMB350_CHARGER is not set
# CONFIG_BATTERY_BQ28400 is not set
# CONFIG_BATTERY_MSM is not set
# CONFIG_FUELGAUGE_DUMMY is not set
#
# MAX77803 Charger
#
CONFIG_BATTERY_SAMSUNG=y
CONFIG_SAMSUNG_LPM_MODE=y
CONFIG_FUELGAUGE_MAX17048=y
CONFIG_CHARGER_MAX77803=y
CONFIG_I2C_GPIO=y

#
# Actuator
#
CONFIG_I2C_ACTUATOR=y

# BT
CONFIG_BT_BCM4335=y
CONFIG_HID_KK_UPGRADE=y

# Earjack
# CONFIG_SAMSUNG_JACK is not set
# CONFIG_INPUT_GPIO=y
CONFIG_SND_JACK=y

# DHA Solution
CONFIG_SEC_DHA_SOL_MAL=y

# Ringtone Gain
CONFIG_SEC_DEVIDE_RINGTONE_GAIN=n

#
# Remove Qualcomm Wifi features
#
CONFIG_MSM_PIL_PRONTO=n
CONFIG_WCNSS_CORE=n
CONFIG_WCNSS_CORE_PRONTO=n
#
# Wifi features (Broadcomm)
#
# CONFIG_MODULES is not set
# CONFIG_MODULE_UNLOAD is not set
# CONFIG_MODULE_FORCE_UNLOAD is not set
CONFIG_NET_CORE=y
CONFIG_WIRELESS=y
CONFIG_WIRELESS_EXT_SYSFS=y
CONFIG_WEXT_CORE=y
CONFIG_WEXT_PROC=y
CONFIG_CFG80211=y
CONFIG_CFG80211_DEFAULT_PS=y
CONFIG_CFG80211_ALLOW_RECONNECT=y
CONFIG_WLAN=y
CONFIG_WIFI_CONTROL_FUNC=y
CONFIG_BCM4335=y
CONFIG_BCM4335BT=y
CONFIG_BCMDHD_FW_PATH="/system/etc/wifi/bcmdhd_sta.bin"
CONFIG_BCMDHD_NVRAM_PATH="/system/etc/wifi/nvram_net.txt"
CONFIG_BROADCOM_WIFI_RESERVED_MEM=y
CONFIG_WLAN_REGION_CODE=100
CONFIG_MMC_MSM_SDC2_SUPPORT=y

# usb host
CONFIG_USB_STORAGE_DETECT=y
CONFIG_USB_HOST_NOTIFY=y
CONFIG_USB_GSPCA=n

# Input Devices
CONFIG_TOUCHSCREEN_SYNAPTICS_I2C_RMI=n
CONFIG_TOUCHSCREEN_SYNAPTICS_I2C_RMI_S5000=y
CONFIG_KEYBOARD_CYPRESS_TOUCHKEY_KS01=y
#CONFIG_INPUT_WACOM=y
#
# eDP ESD FUNCTION
#
CONFIG_EDP_ESD_FUNCTION=y
CONFIG_EDP_TCON_MDNIE=y

#one wire
# CONFIG_W1=n
# CONFIG_W1_MASTER_GPIO_MSM=n
# CONFIG_W1_SLAVE_DS28EL15=n

#
# Sensor hub
#
CONFIG_SENSORS_SSP_ATMEL=y
CONFIG_SENSORS_SSP_MAX88920=y
CONFIG_SENSORS_SSP_CM3320=y
CONFIG_SENSORS_SSP=y
CONFIG_SENSORS_SYSFS=y
CONFIG_SENSORS_SSP_FACTORY=y
CONFIG_SENSORS_SSP_MPU6500=y
CONFIG_SENSORS_SSP_YAS532=y
CONFIG_SENSORS_SSP_BMP182=y
CONFIG_SENSORS_SSP_SHTC1=y
CONFIG_SENSORS_SSP_ATUC128L5HAR=y
CONFIG_SENSORS_SSP_SENSORHUB=y
CONFIG_SEC_FPGA=y
CONFIG_IR_REMOCON_FPGA=y
CONFIG_SENSORS_ADSP=n
# Audience
CONFIG_SND_SOC_ES325=y
CONFIG_SND_SOC_ES325_SLIM=y
CONFIG_FW_LOADER=y
CONFIG_FIRMWARE_IN_KERNEL=y
CONFIG_EXTRA_FIRMWARE="audience-es325-fw-KS01-eur.bin"
CONFIG_EXTRA_FIRMWARE_DIR="firmware"

#Debug
CONFIG_ANDROID_RAM_CONSOLE=y
CONFIG_SEC_LOG_LAST_KMSG=y
CONFIG_SEC_DEBUG_NOCACHE_LOG_IN_LEVEL_LOW=y

# Hall ic
CONFIG_SENSORS_HALL=y

# NFC
CONFIG_BCM2079X_NFC_I2C=y

# SSWAP
CONFIG_SWAP=n
CONFIG_FRONTSWAP=n
CONFIG_ZSMALLOC_NEW=n
CONFIG_PGTABLE_MAPPING=y
CONFIG_ZSWAP=n
CONFIG_DIRECT_RECLAIM_FILE_PAGES_ONLY=y
CONFIG_INCREASE_MAXIMUM_SWAPPINESS=n
CONFIG_FIX_INACTIVE_RATIO=y
CONFIG_TIGHT_PGDAT_BALANCE=y
CONFIG_VNSWAP=y
CONFIG_SWAP_ENABLE_READAHEAD=n

# SDC3
CONFIG_MMC_MSM_SDC3_SUPPORT=y

# KOR USER RESET DEBUG
CONFIG_USER_RESET_DEBUG=y
CONFIG_SEC_DEBUG_LMK_MEMINFO=y

#CONFIG_MSM_VCAP=y
#CONFIG_RADIO_ADAPTERS=y
CONFIG_S5K6B2YX=y

CONFIG_USB_ANDROID_SAMSUNG_COMPOSITE=y
CONFIG_USB_DUN_SUPPORT=y
CONFIG_USB_NCM_SUPPORT_MTU_CHANGE=y

# Battery
# CONFIG_SAMSUNG_BATTERY_DISALLOW_DEEP_SLEEP=y

# FS
CONFIG_F2FS=y
CONFIG_CIFS=y
CONFIG_CIFS_WEAK_PW_HASH=y
CONFIG_CIFS_DFS_UPCALL=y

#
# DWC3 usb 3.0 driver
#
CONFIG_USB_XHCI_HCD=y
CONFIG_USB_DWC3=y
CONFIG_USB_DWC3_MSM=y

CONFIG_SEC_LOG_LAST_KMSG=y

CONFIG_MEDIA_TUNER=n

CONFIG_MEDIA_TUNER_SIMPLE=n
CONFIG_MEDIA_TUNER_TDA8290=n
CONFIG_MEDIA_TUNER_TDA827X=n
CONFIG_MEDIA_TUNER_TDA18271=n
CONFIG_MEDIA_TUNER_TDA9887=n
CONFIG_MEDIA_TUNER_TEA5761=n
CONFIG_MEDIA_TUNER_TEA5767=n
CONFIG_MEDIA_TUNER_MT20XX=n
CONFIG_MEDIA_TUNER_MT2060=n
CONFIG_MEDIA_TUNER_MT2063=n
CONFIG_MEDIA_TUNER_MT2266=n
CONFIG_MEDIA_TUNER_MT2131=n
CONFIG_MEDIA_TUNER_QT1010=n
CONFIG_MEDIA_TUNER_XC2028=n
CONFIG_MEDIA_TUNER_XC5000=n
CONFIG_MEDIA_TUNER_XC4000=n
CONFIG_MEDIA_TUNER_MXL5005S=n
CONFIG_MEDIA_TUNER_MXL5007T=n
CONFIG_MEDIA_TUNER_MC44S803=n
CONFIG_MEDIA_TUNER_MAX2165=n
CONFIG_MEDIA_TUNER_TDA18218=n
CONFIG_MEDIA_TUNER_TDA18212=n
```
